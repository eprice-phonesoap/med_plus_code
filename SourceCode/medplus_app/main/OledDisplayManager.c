/**
@file			  UVCleaningApp.c
@author			  JGS
@brief			  UV Cleaning Application related functions definitions
*/


//_____I N C L U D E ________________________________________________________
// Place here all includes needed by this file starting with its own header
// showing the reason of the include.

#include "freertos/FreeRTOS.h"
#include "esp_system.h"
#include "esp_event.h"
#include "esp_event_loop.h"
#include "driver/gpio.h"
#include "esp_log.h"
#include "string.h"

#include "OledDisplayDriver.h"
#include "OledDisplayManager.h"

//_____D E F I N E __________________________________________________________
// local private defines, enums, macros

#define ole_bmp_comps  50    //BYTE    50 bmp comps count

static const uint16_t oled_bmpdata[]={
1,0,5,26,40,
2,130,5,26,40,
3,260,5,26,40,
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50,10402,3,128,24,
};

static const uint8_t oled_db[] ={
0,0,0,0,0,0,0,0,0,128,128,128,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0,
0,0,0,0,0,0,0,0,0,0,0,0,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0,
0,0,0,0,0,0,0,0,0,0,0,0,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0,
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0,0,0,0,1,1,1,1,0,0,0,1,1,0,0,0,0,0,0,0,0,0,0,0,0,0,0,0,0,0,0,0,0,0
};

extern uint8_t OLE_VIEW[8][128];
//_____ T Y P E D E F _______________________________________________________
// local private typedefs, structs, unions
union oleYtype
{
	uint32_t xpoint;
	char p[4];
};
//_____ P R O T O T Y P E S _________________________________________________
// local function declarations
static void ole_bat_findflash(uint16_t fid,uint16_t * obj,uint16_t offset);
static void ole_draw_dataflash(uint16_t sxp,uint8_t x,uint8_t y);

//_____ L O C A L  D A T A __________________________________________________
// local private data (static)
static const uint8_t getFind[8]={0x00,0x01,0x03,0x07,0x0f,0x1f,0x3f,0x7f};  //

uint16_t fd[5];
union oleYtype oleYP;
uint8_t olm_event = OLM_EVENT_DISP_OPENING;
uint8 mCount;

//_____ P U B L I C   F U N C T I O N S _____________________________________
// public interface functions
void OLM_Init(void)
{
	olm_event = OLM_EVENT_DISP_OPENING;
}

void OLD_SetCount(uint8 count)
{
	if(mCount!=count)
	{
		mCount=count;
		OLM_SetEvent(OLM_EVENT_DISP_DJC);
	}
}

void OLM_10ms_Tasks(void)
{
	switch(olm_event)
	{
		case OLM_EVENT_NONE:

			break;
		case OLM_EVENT_DISP_OPENING:
			memset(&OLE_VIEW, 0, sizeof(OLE_VIEW));
			ole_bat_findflash(11,fd,0);
			ole_draw_dataflash(fd[1],0,0);
			OLD_Refresh();
			break;
		case OLM_EVENT_DISP_CLOSING:
			memset(&OLE_VIEW, 0, sizeof(OLE_VIEW));
			ole_bat_findflash(13,fd,0);
			ole_draw_dataflash(fd[1],0,0);
			OLD_Refresh();
			break;
		case OLM_EVENT_DISP_DJC:
			memset(&OLE_VIEW, 0, sizeof(OLE_VIEW));
			ole_bat_findflash(14,fd,0);
			ole_draw_dataflash(fd[1],0,0);

			if(mCount>9)
			{
				ole_bat_findflash(mCount/10+1,fd,0);
				ole_draw_dataflash(fd[1],35,24);

				ole_bat_findflash(mCount%10+1,fd,0);
				ole_draw_dataflash(fd[1],64,24);
			}
			else
			{
				ole_bat_findflash(mCount+1,fd,0);
				ole_draw_dataflash(fd[1],50,24);
			}
			OLD_Refresh();
			break;

		default:
			olm_event = OLM_EVENT_NONE;
			break;
	}

	if(olm_event != OLM_EVENT_NONE)
	{
		olm_event = OLM_EVENT_NONE;
	}
}

void OLM_SetEvent(uint8 Event)
{
	olm_event = Event;
}

 //_____ L O C A L  F U N C T I O N S ________________________________________
 // local interface functions


static void ole_bat_findflash(uint16_t fid,uint16_t * obj,uint16_t offset)
{
	uint16_t i,items;
	uint16_t newxp=0;

	for(i=offset;i<ole_bmp_comps;i++)
	{
		newxp=i*5;

        if(oled_bmpdata[newxp] == fid)
        {
			obj[0]=oled_bmpdata[newxp];
			obj[1]=oled_bmpdata[newxp+1];
			obj[2]=oled_bmpdata[newxp+2];
			obj[3]=oled_bmpdata[newxp+3];
			obj[4]=oled_bmpdata[newxp+4];
			break;
        }
	}
}

static void ole_draw_dataflash(uint16_t sxp,uint8_t x,uint8_t y)
{
	uint8_t i,numy,line,endx,endy;
	uint16_t mxp=sxp;
	uint8_t  getxp=0,xpc=0,ydn=0,y1ofset,ysum;

	line=y/8;
	endx=x+fd[3];
	endy=line+fd[2];

	xpc=0;
	for(i=x;i<endx;i++)
	{
		for(numy=0;numy < fd[2];numy++)
		{
			oleYP.p[numy]= oled_db[mxp+xpc+(numy * fd[3])];
		}
		ydn=0;

		for(numy=line;numy<endy;numy++)
		{
			if(ydn==0)
			{
				y1ofset=y-numy*8;
				ysum=fd[4]+(8-y1ofset);
				oleYP.xpoint <<=y1ofset;
				OLE_VIEW[numy][i] &= getFind[y1ofset];
				OLE_VIEW[numy][i] +=oleYP.p[0];
			}
			else
			{
				if(ysum>8)
				{
				  OLE_VIEW[numy][i] +=oleYP.p[ydn];
				}
				else
				{
				  OLE_VIEW[numy][i] &= (~getFind[y1ofset]);
				  OLE_VIEW[numy][i] +=oleYP.p[ydn];
				}
			}

			ydn++;
		}
		xpc++;
	}
}

